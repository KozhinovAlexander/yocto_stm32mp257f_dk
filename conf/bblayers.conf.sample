## conf/bblayers.conf.sample
```bitbake
LCONF_VERSION = "7"
BBPATH = "${TOPDIR}"
BBFILES ?= ""

BBLAYERS ?= " \
  ##OEROOT##/layers/poky/meta                              \
  ##OEROOT##/layers/poky/meta-poky                         \
  ##OEROOT##/layers/poky/meta-yocto-bsp                    \
  ##OEROOT##/layers/meta-openembedded/meta-oe              \
  ##OEROOT##/layers/meta-openembedded/meta-python          \
  ##OEROOT##/layers/meta-openembedded/meta-networking      \
  ##OEROOT##/layers/meta-openembedded/meta-multimedia      \
  ##OEROOT##/layers/meta-openembedded/meta-filesystems     \
  ##OEROOT##/layers/meta-st-stm32mp                        \
  ##OEROOT##/layers/meta-st-openstlinux                    \
  ##OEROOT##/layers/meta-stm32mp257f-custom                \
"
```

## meta-stm32mp257f-custom/conf/layer.conf
```bitbake
BBPATH .= ":${LAYERDIR}"
BBFILES += "${LAYERDIR}/recipes-*/*/*.bb \
             ${LAYERDIR}/recipes-*/*/*.bbappend"

BBFILE_COLLECTIONS += "stm32mp257f-custom"
BBFILE_PATTERN_stm32mp257f-custom = "^${LAYERDIR}/"
BBFILE_PRIORITY_stm32mp257f-custom = "10"

LAYERSERIES_COMPAT_stm32mp257f-custom = "scarthgap"
LAYERDEPENDS_stm32mp257f-custom = "core meta-st-stm32mp"
```
